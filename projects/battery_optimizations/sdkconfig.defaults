## projects/battery_optimizations/sdkconfig.defaults
```kconfig
# ESP32-S3 Configuration
CONFIG_IDF_TARGET="esp32s3"

# Serial flasher config
CONFIG_ESPTOOLPY_FLASHSIZE_4MB=y
CONFIG_ESPTOOLPY_FLASHMODE_QIO=y
CONFIG_ESPTOOLPY_FLASHFREQ_80M=y

# Compiler options
CONFIG_COMPILER_OPTIMIZATION_SIZE=y

# Log output
CONFIG_LOG_DEFAULT_LEVEL_INFO=y

# Power Management - THERMAL OPTIMIZATION
CONFIG_PM_ENABLE=y
CONFIG_ESP32S3_DEFAULT_CPU_FREQ_MHZ_80=y

# WiFi Configuration - OPTIMIZED FOR LOWER POWER
CONFIG_ESP32_WIFI_STATIC_RX_BUFFER_NUM=6
CONFIG_ESP32_WIFI_DYNAMIC_RX_BUFFER_NUM=16
CONFIG_ESP32_WIFI_DYNAMIC_TX_BUFFER_NUM=16
CONFIG_ESP32_WIFI_AMPDU_TX_ENABLED=y
CONFIG_ESP32_WIFI_TX_BA_WIN=4
CONFIG_ESP32_WIFI_AMPDU_RX_ENABLED=y
CONFIG_ESP32_WIFI_RX_BA_WIN=4

# LWIP
CONFIG_LWIP_LOCAL_HOSTNAME="battery-optimized"

# HTTP Server
CONFIG_HTTPD_MAX_REQ_HDR_LEN=512
CONFIG_HTTPD_MAX_URI_LEN=512

# FAT Filesystem
CONFIG_FATFS_CODEPAGE_437=y
CONFIG_FATFS_LFN_HEAP=y
CONFIG_FATFS_MAX_LFN=255

# SPI Configuration
CONFIG_SPI_MASTER_ISR_IN_IRAM=y

# PSRAM - REDUCED SPEED FOR THERMAL OPTIMIZATION
CONFIG_ESP32S3_SPIRAM_SUPPORT=y
CONFIG_SPIRAM_MODE_OCT=y
CONFIG_SPIRAM_TYPE_AUTO=y
CONFIG_SPIRAM_SPEED_40M=y

# Camera Configuration for OV2640
CONFIG_OV2640_SUPPORT=y
CONFIG_CAMERA_CORE0=y
CONFIG_CAMERA_SCCB_CLK_FREQ=100000

# Camera JPEG buffer for thermal efficiency
CONFIG_CAMERA_CUSTOM_JPEG_BUFFER_SIZE=y
CONFIG_CAMERA_CUSTOM_JPEG_BUFFER_SIZE_BYTES=1048576
```

## projects/camera_oled_display/sdkconfig.defaults
```kconfig
# ESP32S3 Configuration
CONFIG_IDF_TARGET="esp32s3"
CONFIG_ESP32S3_DEFAULT_CPU_FREQ_240=y
CONFIG_ESP32S3_DATA_CACHE_64KB=y
CONFIG_ESP32S3_INSTRUCTION_CACHE_32KB=y

# PSRAM Configuration
CONFIG_SPIRAM=y
CONFIG_SPIRAM_MODE_OCT=y
CONFIG_SPIRAM_SPEED_80M=y
CONFIG_SPIRAM_USE_MALLOC=y
CONFIG_SPIRAM_MALLOC_ALWAYSINTERNAL=16384

# Camera Configuration
CONFIG_ESP32_CAMERA_ENABLED=y
CONFIG_CAMERA_CORE0=y
CONFIG_CAMERA_DMA_BUFFER_SIZE_MAX=32768

# I2C Configuration
CONFIG_I2C_ENABLE_DEBUG_LOG=y

# LVGL Configuration
CONFIG_LV_COLOR_DEPTH_16=y
CONFIG_LV_COLOR_16_SWAP=y
CONFIG_LV_USE_PERF_MONITOR=y
CONFIG_LV_USE_MEM_MONITOR=y
CONFIG_LV_THEME_DEFAULT_DARK=y
CONFIG_LV_FONT_MONTSERRAT_10=y
CONFIG_LV_FONT_MONTSERRAT_12=y
CONFIG_LV_FONT_MONTSERRAT_14=y

# FreeRTOS Configuration
CONFIG_FREERTOS_HZ=1000
CONFIG_FREERTOS_UNICORE=n

# Memory Configuration
CONFIG_ESP_MAIN_TASK_STACK_SIZE=8192
CONFIG_ESP_SYSTEM_EVENT_TASK_STACK_SIZE=4096

# Log Configuration
CONFIG_LOG_DEFAULT_LEVEL_INFO=y
CONFIG_LOG_MAXIMUM_LEVEL_DEBUG=y
```

## projects/hello_wifi/sdkconfig.defaults
```kconfig
# ESP32-S3 Configuration
CONFIG_IDF_TARGET="esp32s3"

# Serial flasher config
CONFIG_ESPTOOLPY_FLASHSIZE_4MB=y
CONFIG_ESPTOOLPY_FLASHMODE_QIO=y
CONFIG_ESPTOOLPY_FLASHFREQ_80M=y

# Compiler options
CONFIG_COMPILER_OPTIMIZATION_SIZE=y

# Log output
CONFIG_LOG_DEFAULT_LEVEL_INFO=y

# WiFi Configuration
CONFIG_ESP32_WIFI_STATIC_RX_BUFFER_NUM=10
CONFIG_ESP32_WIFI_DYNAMIC_RX_BUFFER_NUM=32
CONFIG_ESP32_WIFI_DYNAMIC_TX_BUFFER_NUM=32
CONFIG_ESP32_WIFI_AMPDU_TX_ENABLED=y
CONFIG_ESP32_WIFI_TX_BA_WIN=6
CONFIG_ESP32_WIFI_AMPDU_RX_ENABLED=y
CONFIG_ESP32_WIFI_RX_BA_WIN=6

# LWIP
CONFIG_LWIP_LOCAL_HOSTNAME="hello-wifi"

# HTTP Server
CONFIG_HTTPD_MAX_REQ_HDR_LEN=512
CONFIG_HTTPD_MAX_URI_LEN=512

# FAT Filesystem
CONFIG_FATFS_CODEPAGE_437=y
CONFIG_FATFS_LFN_HEAP=y
CONFIG_FATFS_MAX_LFN=255

# SPI Configuration
CONFIG_SPI_MASTER_ISR_IN_IRAM=y

# PSRAM
CONFIG_ESP32S3_SPIRAM_SUPPORT=y
CONFIG_SPIRAM_MODE_QUAD=y
CONFIG_SPIRAM_TYPE_AUTO=y
CONFIG_SPIRAM_SPEED_80M=y
```

## projects/hello_world/sdkconfig.defaults
```kconfig
# ESP32-S3 Configuration
CONFIG_IDF_TARGET="esp32s3"

# Serial flasher config
CONFIG_ESPTOOLPY_FLASHSIZE_4MB=y
CONFIG_ESPTOOLPY_FLASHMODE_QIO=y
CONFIG_ESPTOOLPY_FLASHFREQ_80M=y

# Compiler options
CONFIG_COMPILER_OPTIMIZATION_SIZE=y

# Log output
CONFIG_LOG_DEFAULT_LEVEL_INFO=y
```

## projects/simple_timelapse/sdkconfig.defaults
```kconfig
# ESP32-S3 specific configuration
CONFIG_IDF_TARGET="esp32s3"
CONFIG_IDF_TARGET_ESP32S3=y

# PSRAM configuration for camera
CONFIG_ESP32S3_SPIRAM_SUPPORT=y
CONFIG_SPIRAM_MODE_OCT=y
CONFIG_SPIRAM_SPEED_80M=y

# Camera Configuration
CONFIG_OV2640_SUPPORT=y
CONFIG_CAMERA_CORE0=y
CONFIG_CAMERA_SCCB_CLK_FREQ=400000

# Increase JPEG buffer size for better quality
CONFIG_CAMERA_CUSTOM_JPEG_BUFFER_SIZE=y
CONFIG_CAMERA_CUSTOM_JPEG_BUFFER_SIZE_BYTES=2097152

# Flash and partition settings
CONFIG_ESPTOOLPY_FLASHSIZE_8MB=y
CONFIG_ESPTOOLPY_FLASHFREQ_80M=y
CONFIG_ESPTOOLPY_FLASHMODE_QIO=y

# FreeRTOS settings
CONFIG_FREERTOS_HZ=1000

# Log output
CONFIG_LOG_DEFAULT_LEVEL_INFO=y

# FAT Filesystem settings
CONFIG_FATFS_CODEPAGE_437=y
CONFIG_FATFS_LFN_HEAP=y
CONFIG_FATFS_MAX_LFN=255

# SPI settings for SD card
CONFIG_SPI_MASTER_ISR_IN_IRAM=y

# WiFi Configuration
CONFIG_ESP_WIFI_SSID="YOUR_WIFI_SSID"
CONFIG_ESP_WIFI_PASSWORD="YOUR_WIFI_PASSWORD"
CONFIG_ESP_MAXIMUM_RETRY=5

# SNTP Configuration
CONFIG_LWIP_SNTP_MAX_SERVERS=3
CONFIG_LWIP_DHCP_MAX_NTP_SERVERS=3

# I2S Configuration for Audio Recording
CONFIG_ESP32S3_DATA_CACHE_LINE_64B=y
```

## projects/time-v1/Kconfig.projbuild
```kconfig
menu "Time-V1 Configuration"

    menu "Timelapse Settings"
        config TIMELAPSE_INTERVAL_SEC
            int "Capture interval (seconds)"
            default 300
            range 30 3600
            help
                Time between timelapse captures in seconds.
                Lower values consume more power.

        config VIDEO_DURATION_SEC
            int "Video duration (seconds)"
            default 5
            range 1 30
            help
                Duration of each timelapse video recording.

        config AUDIO_SAMPLE_RATE
            int "Audio sample rate (Hz)"
            default 16000
            range 8000 48000
            help
                Sample rate for audio capture during video recording.
    endmenu

    menu "Power Management"
        config POWER_BUDGET_MA
            int "Power budget (mA)"
            default 50
            range 20 200
            help
                Average power consumption target for battery life optimization.

        config DEEP_SLEEP_ENABLED
            bool "Enable deep sleep between captures"
            default y
            help
                Use deep sleep mode to minimize power consumption.

        config WAKE_STUB_ENABLED
            bool "Enable wake stub for faster startup"
            default y
            help
                Use wake stub to reduce boot time from deep sleep.
    endmenu

    menu "WiFi Configuration"
        config WIFI_SSID
            string "WiFi SSID"
            default "pianomaster"
            help
                WiFi network name for NTP sync and initial setup.

        config WIFI_PASSWORD
            string "WiFi Password"
            default "happyness"
            help
                WiFi network password.

        config NTP_SERVER
            string "NTP Server"
            default "pool.ntp.org"
            help
                NTP server for time synchronization.
    endmenu

    menu "Storage Configuration"
        config SD_MOUNT_POINT
            string "SD card mount point"
            default "/sdcard"
            help
                Mount point for SD card filesystem.

        config VIDEO_QUALITY
            int "Video quality (1-10)"
            default 8
            range 1 10
            help
                JPEG quality for video frames (10 = highest quality).

        config STORAGE_BUFFER_SIZE
            int "Storage buffer size (KB)"
            default 64
            range 32 256
            help
                Buffer size for SD card write operations.
    endmenu

    menu "ESP-NOW Configuration"
        config ESP_NOW_CHANNEL
            int "ESP-NOW WiFi channel"
            default 1
            range 1 13
            help
                WiFi channel for ESP-NOW communication.

        config ESP_NOW_ENCRYPT
            bool "Enable ESP-NOW encryption"
            default y
            help
                Use encryption for ESP-NOW packets.

        config GATEWAY_MAC_ADDR
            string "Gateway MAC Address"
            default "00:00:00:00:00:00"
            help
                MAC address of the gateway device (set to 00:00:00:00:00:00 for auto-discovery).
    endmenu

    menu "Stats Engine"
        config STATS_BUFFER_SIZE
            int "Stats buffer entries"
            default 1000
            range 100 5000
            help
                Number of statistics entries to buffer in memory.

        config STATS_FLUSH_INTERVAL
            int "Stats flush interval (seconds)"
            default 60
            range 10 300
            help
                How often to flush stats buffer to SD card.

        config ENABLE_POWER_STATS
            bool "Enable power consumption tracking"
            default y
            help
                Track and log power consumption metrics.

        config ENABLE_TIMING_STATS
            bool "Enable timing statistics"
            default y
            help
                Track operation timing for performance analysis.
    endmenu

endmenu
```
